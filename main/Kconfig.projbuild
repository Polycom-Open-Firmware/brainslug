## main/Kconfig.projbuild
```kconfig
menu "Probe board"

choice PROBE_BOARD
    prompt "Target board"
    default PROBE_BOARD_WESP32 if IDF_TARGET_ESP32
    default PROBE_BOARD_S3_POE_ETH_CAM if IDF_TARGET_ESP32S3
    help
        Selects which physical board this firmware targets. The eth init
        path, GPIO whitelist, and presence of the camera endpoints all
        change based on this.

config PROBE_BOARD_WESP32
    bool "Silicognition wESP32 (ESP32 + LAN8720, internal EMAC over RMII)"
    depends on IDF_TARGET_ESP32

config PROBE_BOARD_S3_POE_ETH_CAM
    bool "Waveshare ESP32-S3-POE-ETH-CAM-KIT (ESP32-S3 + W5500 SPI eth + OV2640)"
    depends on IDF_TARGET_ESP32S3

endchoice

config PROBE_CAMERA
    bool "Expose /camera HTTP endpoints (OV2640 via esp32-camera)"
    depends on PROBE_BOARD_S3_POE_ETH_CAM
    default y

config PROBE_AUDIO
    bool "ADC mic capture + on-device FFT, streamed over /audio/ws"
    default n
    help
        Captures audio from ADC_MIC_CHANNEL (see probe.h), runs a real-
        valued FFT via esp-dsp, and streams magnitude bins over a
        WebSocket at /audio/ws. Wire a crude electret + bias network
        to the configured ADC pin. Used by the TC8 smoke harness to
        verify audio output: TC8 plays a tone, brainslug confirms the
        peak in the expected FFT bin.

endmenu
```
